	INCLUDE TG110F32.inc		; CPU register definitions			
	IMPORT	SPIbuf
	IMPORT	DMA_c0	

A0	EQU	1<<7			; A0 = PB.7
RST	EQU	1<<8			; RST = PB.8
CS	EQU	1<<11			; CS = PB.11

	PRESERVE8
	THUMB				; use thumb instruction set
		
	AREA	RAM, DATA, NOINIT, READWRITE, ALIGN=3
LCD_buf	SPACE	128*4			; LCD buffer
col	SPACE	2			; LCD column number
pag	SPACE	2			; LCD page number	
	EXPORT	LCD_buf	
		
	AREA    |.text|, CODE, READONLY
SPI_transfer	PROC
	EXPORT	SPI_transfer
	PUT	SLEEPONEXIT, 0, SCB_SCR ; set sleep on exit
	movw	R1, #CS			; CS down
	strh	R1, [R12, #GPIO_PB_DOUTCLR]
	PUT	0xF9, USARTn_IFC, USART0 ; clear USART interrupt flags
	PUT	0x02, USARTn_IEN	; enable TXBL interrupt
	wfi
	movw	R1, #CS			; CS up
	strh	R1, [R12, #GPIO_PB_DOUTSET]
	bx	LR
	ENDP
	LTORG
;---------------------------------------------------------------------	
Set_Cursor	PROC			; R2: 0 0 x y
 	push	{LR}
	ldr	R11, =SPIbuf
	mov	R1, R2			; R1: 0 0 x y
	orr	R1, #0xB0		; add page address set cmd
	strb	R1, [R11, #2]	
	rev16	R2, R2			; R2: 0 0 y x
	lsl	R1, R2, #4
	rev16	R1, R1
	and	R1, #0x0F
	orr	R1, #0x10		; add column set address cmd
	strb	R1, [R11]	
	and	R2, #0x0F
	strb	R2, [R11, #1]

	movs	R1, #A0			; set A0 = 0	
	str	R1, [R12, #GPIO_PB_DOUTCLR]
	movs	R3, #3			; send 3 bytes
	movs	R4, #0			; do not receive bytes
	bl	SPI_transfer	
	movs	R1, #A0			; set A0 = 1	
	str	R1, [R12, #GPIO_PB_DOUTSET]
	pop	{PC}
	ENDP

;---------------------------------------------------------------------
Display_Bitmap	PROC			; R5=bitmap offset, R6=x, R7=width
	EXPORT	Display_Bitmap
	push	{LR}	
	movs	R8, #3			; initial page number

dbm1	mov	R2, R6			; R2: 0 0 0 x
	rev16	R2, R2			; R2: 0 0 x 0
	orr 	R2, R8			; R2: 0 0 x y
	bl	Set_Cursor		; set page & column
		
	mov	R11, R5			; source address
	mov	R3, R7			; # of bytes to send
	movs	R4, #0			; # of bytes to receive
	bl	SPI_transfer		; send bitmap row
	add	R5, R7			; advance bitmap pointer

	subs	R8, #1			; loop over LCD pages
	bpl	dbm1
	pop	{PC}
	ENDP

;-----------------------------------------------------------------------
Display_Value	PROC			; value = R10 < 999
	EXPORT	Display_Value	
	push	{LR}
	ldr	R5, =OK			; display OK if R10 >= 0
	cmp	R10, #0
	bpl	dv0
	rsb	R10, #0			; R10 = |R10|
	ldr	R5, =ER			; .. and ER otherwise
dv0	movs	R6, #75			; column address for OK/ER
	movs	R7, #53			; bitmap width for OK/ER
	bl	Display_Bitmap		; display OK/ER
	
	movw	R6, #((19+2)*2)		; x-coord of digit 3
	movs	R9, #3			; display 3 digits
dv1	movs	R1, #10
	udiv	R7, R10, R1		; R7 = N/10
	mls	R5, R7, R1, R10		; R5 = N%10 
	mov	R10, R7			; R10 = N/10
	movs	R1, #(19*4)		; R1 = font char size
	mul	R5, R1			; R5 = offset in font table
	ldr	R11, =Font		; R11 = font address	
	add	R5, R11			; R5=bitmap address
	movs	R7, #19			; R7=font width
	bl	Display_Bitmap		; display 1st digit
	sub	R6, #(19+2)		; update x-coord
	subs	R9, #1
	bne	dv1
		
	pop	{PC}
	ENDP
		
;---------------------------------------------------------------------		
Init_LCD	PROC
	EXPORT	Init_LCD
	push	{LR}
	ldr	R12, =GPIO		; pointer to GPIO
	movw	R1, #RST		; clear RST for 5 msec
	str	R1, [R12, #GPIO_PB_DOUTCLR]	
	movw	R0, #35000		; power-up delay
	subs	R0, #1
	bne	.-2	
	str	R1, [R12, #GPIO_PB_DOUTSET]

	movs	R0, #0x00		; power-up delay
	movt	R0, #0x10
	subs	R0, #1
	bne	.-2
	
	ldr	R11, =LCD_INI		; pointer to init data		
	movs	R3, #16			; data size
	bl	SPI_transfer		; send LCD init data
	movs	R1, #A0			; A0 = 1	
	str	R1, [R12, #GPIO_PB_DOUTSET]

	bl	Clear_Buffer
	bl	Load_LCD_IRQ
	mov	R6, #0			; x -coord
	pop	{PC}
	ENDP

;-------------------------------------------------------------
Clear_Buffer	PROC
	EXPORT	Clear_Buffer
	ldr	R5, =LCD_buf		; clear LCD buffer
	movw	R3, #128
	movw	R1, #0
	movt	R1, #0
cbb	str	R1, [R5], #4
	subs	R3, #1
	bne	cbb
	sub	R5, #(128*4)	
	bx	LR
	ENDP
	LTORG
	
;---------------------------------------------------------------------
Load_LCD_IRQ	PROC
	EXPORT	Load_LCD_IRQ
	ldr	R11, =LCD_buf		; load LCD row from buffer
	movs	R7, #3			; init page number
	movw	R1, #CS			; CS down
	strh	R1, [R12, #GPIO_PB_DOUTCLR]
	
ll_loop	push	{R11}
	ldr	R11, =SPIbuf
	movw	R1, #0x40B0		; set page # command
	movt	R1, #0x0010		; clear column address
	orr	R1, R7			; add page #
	str	R1, [R11]		; load command to buffer
	movs	R3, #4			; SPI transfer size
	movs	R1, #A0			; set A0 = 0	
	str	R1, [R12, #GPIO_PB_DOUTCLR]
	PUT	SLEEPONEXIT, 0, SCB_SCR ; set sleep on exit
	PUT	0xF9, USARTn_IFC, USART0 ; clear USART interrupt flags
	PUT	0x02, USARTn_IEN	; enable TXBL interrupt
	wfi				; send command to LCD
	movs	R1, #A0			; set A0 = 1	
	str	R1, [R12, #GPIO_PB_DOUTSET]
	pop	{R11}

	movs	R3, #128		; # of cols to load
	PUT	SLEEPONEXIT, 0, SCB_SCR ; set sleep on exit
	PUT	0xF9, USARTn_IFC, USART0 ; clear USART interrupt flags
	PUT	0x02, USARTn_IEN	; enable TXBL interrupt
	wfi				; send data to LCD
	subs	R7, #1			; decrement row
	bge	ll_loop
	
	movw	R1, #CS			; CS up
	strh	R1, [R12, #GPIO_PB_DOUTSET]
	bx	LR
	ENDP
	LTORG
	
;------------------------------------------------------------------------
	ALIGN
LCD_INI	
	DCW	0x00AC, 0xA5AF, 0xA0A2, 0x20C0, 0x3781, 0xA42F, 0x01AC, 0xAF40
	
;----------------------------------------------------------------------
Font	; 19x32 font
	DCB	0x00, 0x03, 0x0F, 0x1F, 0x3F, 0x7F, 0x7F, 0xFF, 0xE0, 0xC0, 0xE0	; 0
	DCB	0xFF, 0x7F, 0x7F, 0x3F, 0x1F, 0x0F, 0x03, 0x00
	DCB	0x3F, 0xFF, 0xFF, 0xFF, 0xFF, 0xFF, 0xFF, 0xFF, 0x00, 0x00, 0x00
	DCB	0xFF, 0xFF, 0xFF, 0xFF, 0xFF, 0xFF, 0xFF, 0x3F
	DCB	0xFC, 0xFF, 0xFF, 0xFF, 0xFF, 0xFF, 0xFF, 0xFF, 0x00, 0x00, 0x00
	DCB	0xFF, 0xFF, 0xFF, 0xFF, 0xFF, 0xFF, 0xFF, 0xFC
	DCB	0x00, 0xC0, 0xF0, 0xF8, 0xFC, 0xFE, 0xFE, 0xFF, 0x07, 0x03, 0x07
	DCB	0xFF, 0xFE, 0xFE, 0xFC, 0xF8, 0xF0, 0xC0, 0x00

	DCB	0x00, 0x00, 0x01, 0x01, 0x03, 0x03, 0x07, 0x0F, 0x1F, 0x7F, 0xFF	; 1
	DCB	0xFF, 0xFF, 0xFF, 0x00, 0x00, 0x00, 0x00, 0x00
	DCB	0x00, 0x00, 0xC0, 0xC0, 0xC0, 0xC0, 0xFF, 0xFF, 0xFF, 0xFF, 0xFF
	DCB	0xFF, 0xFF, 0xFF, 0x00, 0x00, 0x00, 0x00, 0x00
	DCB	0x00, 0x00, 0x00, 0x00, 0x00, 0x00, 0xFF, 0xFF, 0xFF, 0xFF, 0xFF
	DCB	0xFF, 0xFF, 0xFF, 0x00, 0x00, 0x00, 0x00, 0x00
	DCB	0x00, 0x00, 0x00, 0x00, 0x07, 0x07, 0xFF, 0xFF, 0xFF, 0xFF, 0xFF
	DCB	0xFF, 0xFF, 0xFF, 0x07, 0x07, 0x00, 0x00, 0x00

	DCB	0x07, 0x1F, 0x3F, 0x7F, 0x7F, 0xFF, 0xFF, 0xE0, 0xC0, 0xC0, 0xE0	; 2
	DCB	0xFF, 0xFF, 0x7F, 0x7F, 0x3F, 0x1F, 0x0F, 0x03
	DCB	0x80, 0xE0, 0xE0, 0xE0, 0xE0, 0xE0, 0xC0, 0x00, 0x00, 0x01, 0x0F
	DCB	0xFF, 0xFF, 0xFF, 0xFF, 0xFF, 0xFF, 0xFC, 0xF0
	DCB	0x00, 0x00, 0x00, 0x01, 0x03, 0x07, 0x1F, 0x3E, 0x7E, 0xFC, 0xF8
	DCB	0xF0, 0xE0, 0xE0, 0xC0, 0x81, 0x01, 0x01, 0x01
	DCB	0x3F, 0x7F, 0xFF, 0xFF, 0xFF, 0xBF, 0x3F, 0x3F, 0x3F, 0x3F, 0x3F
	DCB	0x3F, 0x3F, 0x3F, 0x7F, 0xFF, 0xFF, 0xFE, 0xE0

	DCB	0x0F, 0x1F, 0x3F, 0x7F, 0x7F, 0xFF, 0xE0, 0xC0, 0xC0, 0xE0, 0xF0	; 3
	DCB	0xFF, 0x7F, 0x7F, 0x7F, 0x3F, 0x1F, 0x07, 0x00
	DCB	0x80, 0xC0, 0xC0, 0xC0, 0xC3, 0x83, 0x03, 0x03, 0x03, 0x07, 0x0F
	DCB	0xFF, 0xFF, 0xFD, 0xFC, 0xF8, 0xF0, 0xC0, 0x00
	DCB	0x01, 0x03, 0x03, 0x03, 0x03, 0x01, 0x00, 0x00, 0x00, 0x80, 0xE0
	DCB	0xFF, 0xFF, 0xFF, 0xFF, 0xFF, 0x7F, 0x3F, 0x0F
	DCB	0xF0, 0xF8, 0xFC, 0xFE, 0xFE, 0xFF, 0x07, 0x03, 0x03, 0x07, 0x0F
	DCB	0xFF, 0xFE, 0xFE, 0xFE, 0xFC, 0xF8, 0xF0, 0xC0

	DCB	0x00, 0x00, 0x00, 0x00, 0x00, 0x00, 0x00, 0x00, 0x00, 0x01, 0x03	; 4
	DCB	0x0F, 0x3F, 0xFF, 0xFF, 0xFF, 0xFF, 0x00, 0x00
	DCB	0x00, 0x00, 0x00, 0x00, 0x01, 0x07, 0x0F, 0x3E, 0x78, 0xFF, 0xFF
	DCB	0xFF, 0xFF, 0xFF, 0xFF, 0xFF, 0xFF, 0x00, 0x00
	DCB	0x07, 0x0F, 0x3F, 0x7F, 0xFB, 0xE3, 0x83, 0x03, 0x03, 0xFF, 0xFF
	DCB	0xFF, 0xFF, 0xFF, 0xFF, 0xFF, 0xFF, 0x03, 0x03
	DCB	0x00, 0x00, 0x00, 0x00, 0x00, 0x00, 0x00, 0x07, 0x07, 0xFF, 0xFF
	DCB	0xFF, 0xFF, 0xFF, 0xFF, 0xFF, 0xFF, 0x07, 0x07

	DCB	0x00, 0x00, 0xFF, 0xFF, 0xFF, 0xFC, 0xFC, 0xFC, 0xFC, 0xFC, 0xFC	; 5
	DCB	0xFC, 0xFC, 0xFC, 0xFC, 0xFC, 0xFC, 0x00, 0x00
	DCB	0x00, 0x3F, 0xFF, 0xFF, 0xFF, 0x1F, 0x1C, 0x1C, 0x1C, 0x1E, 0x1F
	DCB	0x1F, 0x0F, 0x0F, 0x0F, 0x07, 0x03, 0x01, 0x00
	DCB	0x01, 0x83, 0x83, 0x83, 0x83, 0x01, 0x00, 0x00, 0x00, 0x00, 0x00
	DCB	0xFF, 0xFF, 0xFF, 0xFF, 0xFF, 0xFF, 0xFF, 0x3F
	DCB	0xF0, 0xF8, 0xFC, 0xFE, 0xFE, 0xFF, 0x03, 0x03, 0x03, 0x03, 0x07
	DCB	0xFF, 0xFE, 0xFE, 0xFC, 0xF8, 0xF0, 0xE0, 0x80

	DCB	0x00, 0x00, 0x03, 0x07, 0x0F, 0x1F, 0x3F, 0x3F, 0x7C, 0x70, 0xF0	; 6
	DCB	0xE0, 0xE0, 0xC0, 0xC0, 0xC0, 0xC0, 0x00, 0x00
	DCB	0x1F, 0xFF, 0xFF, 0xFF, 0xFF, 0xFF, 0xFF, 0xFF, 0x70, 0x70, 0x70
	DCB	0x7F, 0x7F, 0x7F, 0x3F, 0x3F, 0x1F, 0x07, 0x01
	DCB	0xFE, 0xFF, 0xFF, 0xFF, 0xFF, 0xFF, 0xFF, 0xFF, 0x00, 0x00, 0x00
	DCB	0xFF, 0xFF, 0xFF, 0xFF, 0xFF, 0xFF, 0xFF, 0xFF
	DCB	0x00, 0xE0, 0xF0, 0xFC, 0xFE, 0xFE, 0xFF, 0xFF, 0x07, 0x03, 0x07
	DCB	0xFF, 0xFE, 0xFE, 0xFC, 0xFC, 0xF8, 0xE0, 0x00

	DCB	0x3F, 0xFF, 0xFF, 0xFF, 0xFE, 0xFC, 0xFC, 0xFC, 0xFC, 0xFC, 0xFC	; 7
	DCB	0xFC, 0xFC, 0xFF, 0xFF, 0xFF, 0xFE, 0xF8, 0xE0
	DCB	0x80, 0x80, 0x80, 0x80, 0x00, 0x00, 0x00, 0x00, 0x00, 0x03, 0x0F
	DCB	0x3F, 0xFF, 0xFF, 0xF8, 0xC0, 0x00, 0x00, 0x00
	DCB	0x00, 0x00, 0x00, 0x00, 0x00, 0x00, 0x01, 0x1F, 0xFF, 0xFF, 0xFF
	DCB	0xFF, 0xFF, 0xC0, 0x00, 0x00, 0x00, 0x00, 0x00
	DCB	0x00, 0x00, 0x00, 0x00, 0x07, 0x07, 0xFF, 0xFF, 0xFF, 0xFF, 0xFF
	DCB	0xFF, 0xFF, 0x07, 0x07, 0x00, 0x00, 0x00, 0x00

	DCB	0x00, 0x07, 0x1F, 0x3F, 0x7F, 0x7F, 0xFF, 0xF0, 0xE0, 0xC0, 0xC0	; 8
	DCB	0xE0, 0xF0, 0x7F, 0x7F, 0x3F, 0x1F, 0x07, 0x00
	DCB	0x00, 0xE0, 0xFC, 0xFE, 0xFF, 0xFF, 0xFF, 0xFF, 0x7F, 0x3F, 0x1F
	DCB	0x0F, 0x3F, 0xFF, 0xFF, 0xF9, 0xF0, 0xC0, 0x00
	DCB	0x07, 0x1F, 0x3F, 0x7F, 0xFF, 0xFF, 0xF0, 0xE0, 0xF0, 0xF8, 0xF8
	DCB	0xFC, 0xFF, 0xFF, 0xFF, 0xFF, 0xFF, 0x7F, 0x1F
	DCB	0xC0, 0xF0, 0xFC, 0xFC, 0xFE, 0xFE, 0x1F, 0x07, 0x03, 0x03, 0x03
	DCB	0x07, 0x0E, 0xFE, 0xFE, 0xFC, 0xF8, 0xF0, 0xC0

	DCB	0x00, 0x07, 0x0F, 0x3F, 0x7F, 0x7F, 0xFF, 0xFF, 0xC0, 0xC0, 0xC0	; 9
	DCB	0xFF, 0xFF, 0x7F, 0x7F, 0x3F, 0x1F, 0x07, 0x00
	DCB	0xFF, 0xFF, 0xFF, 0xFF, 0xFF, 0xFF, 0xFF, 0xFF, 0x00, 0x00, 0x00
	DCB	0xFF, 0xFF, 0xFF, 0xFF, 0xFF, 0xFF, 0xFF, 0x7F
	DCB	0x80, 0xE0, 0xF8, 0xFC, 0xFC, 0xFE, 0xFE, 0xFE, 0x1E, 0x0E, 0x1C
	DCB	0xFF, 0xFF, 0xFF, 0xFF, 0xFF, 0xFF, 0xFF, 0xF8
	DCB	0x00, 0x00, 0x03, 0x03, 0x03, 0x03, 0x07, 0x07, 0x0E, 0x0E, 0x3E
	DCB	0xFC, 0xFC, 0xF8, 0xF8, 0xF0, 0xC0, 0x00, 0x00	
	
OK	;DCB      0x35, 0x04 ; WxH of "OK"
	DCB      0x00, 0x01, 0x03, 0x0F, 0x1F, 0x3F, 0x7F, 0x7E, 0x7C, 0xFC
	DCB      0xF8, 0xF8, 0xF8, 0xF8, 0xF8, 0xFC, 0x7C, 0x7E, 0x3F, 0x3F
	DCB      0x1F, 0x0F, 0x03, 0x01, 0x00, 0x00, 0x00, 0x00, 0x00, 0x00
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	DCB      0x1F, 0x0F, 0x03

ER	;DCB      0x35, 0x04 ; WxH of "ER"
	DCB      0xFF, 0xFF, 0xFF, 0xFF, 0xFF, 0xF8, 0xF8, 0xF8, 0xF8, 0xF8
	DCB      0xF8, 0xF8, 0xF8, 0xF8, 0xF8, 0xF8, 0xF8, 0xF8, 0xF8, 0xF8
	DCB      0x00, 0x00, 0x00, 0x00, 0x00, 0xFF, 0xFF, 0xFF, 0xFF, 0xFF
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	DCB	 0x00, 0x00, 0x00

	ALIGN
	END