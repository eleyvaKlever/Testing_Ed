	INCLUDE TG110F32.inc		; CPU register definitions
	IMPORT	SPIbuf
	IMPORT Readbuf	
	
CS	EQU	1<<14			; CS =  PC.14 (chip select)	
CTS	EQU	1<<15			; CTS = PC.15 (clear to send)
	
	PRESERVE8
	THUMB				; use thumb instruction set
	AREA    |.text|, CODE, READONLY

;-----------------------------------------------------------------
SI4461_setup	PROC
	EXPORT	SI4461_setup
	push	{LR}
	movs	R0, #0x00		; power-up delay
	movt	R0, #0x10
	subs	R0, #1
	bne	.-2	
	
	ldr	R11, =SI4461_Config
	ldrb	R2, [R11], #1		; get # of commands to send
s4s	bl	Send_SI4461
	subs	R2, #1
	bne	s4s
	pop	{PC}
	ENDP
		
;-----------------------------------------------------------------
Send_SI4461	PROC			; send command/data/property to Si4012
	EXPORT	Send_SI4461	
	movs	R4, #0			; no bytes to receive		
Read_SI4461				; R4 is set by caller
	EXPORT	Read_SI4461
wcts	ldrh	R1, [R12, #GPIO_PC_DIN]	; check CTS flag
	tst	R1, #CTS		; wait for CTS
	beq	wcts

	ldrb	R3, [R11], #1		; get transfer size in R3
	PUT	SLEEPONEXIT, 0, SCB_SCR ; set sleep on exit
	movw	R1, #CS			; CS down
	strh	R1, [R12, #GPIO_PC_DOUTCLR]
	PUT	0xF9, USARTn_IFC, USART0 ; clear USART interrupt flags
	ldr	R1, [R0, #USARTn_RXDATA]
	PUT	0x02, USARTn_IEN	; enable TXBL interrupt
	wfi
	movw	R1, #CS			; CS up
	strh	R1, [R12, #GPIO_PC_DOUTSET]
	ldrb	R1, [R0, #USARTn_RXDATA]
	bx	LR
	ENDP

;---------------------------------------------------------------------	
	ALIGN
SI4461_Config	
        DCB     0x1E    ; config data size
        DCB     0x07, 0x02, 0x01, 0x00, 0x01, 0xC9, 0xC3, 0x80
        DCB     0x08, 0x13, 0x00, 0x08, 0x00, 0x00, 0x27, 0x00, 0x00
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        DCB     0x0C, 0x11, 0x40, 0x08, 0x00, 0x3B, 0x09, 0x99, 0x99, 0x22, 0x22, 0x20, 0xFF
	
	ALIGN
	END	