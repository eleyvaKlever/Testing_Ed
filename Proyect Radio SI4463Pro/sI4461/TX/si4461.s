	INCLUDE TG110F32.inc		; CPU register definitions
	IMPORT	SPIbuf
	
CS	EQU	1<<14			; CS =  PC.14 (chip select)	
CTS	EQU	1<<15			; CTS = PC.15 (clear to send)
	
	PRESERVE8
	THUMB				; use thumb instruction set
	AREA    |.text|, CODE, READONLY

;-----------------------------------------------------------------
SI4461_setup	PROC
	EXPORT	SI4461_setup
	push	{LR}
	ldr	R12, =GPIO		; pointer to GPIO
	ldr	R11, =SI4461_Config
	ldrb	R2, [R11], #1		; get # of commands to send
s4s	bl	Send_SI4461
	subs	R2, #1
	bne	s4s
	
	ldr	R11, =SPIbuf
	movw	R1, #0x3402		; SLEEP
	movt	R1, #0x0001
	str	R1, [R11]	
	bl	Send_SI4461	
	
	pop	{PC}
	ENDP
		
;-----------------------------------------------------------------
Send_SI4461	PROC			; send command/data/property to Si4012
	EXPORT	Send_SI4461
wcts	ldrh	R3, [R12, #GPIO_PC_DIN]	; check CTS flag
	tst	R3, #CTS		; wait for CTS
	beq	wcts

	ldrb	R3, [R11], #1		; get transfer size in R3		
	PUT	SLEEPONEXIT, 0, SCB_SCR ; set sleep on exit
	movw	R1, #CS			; CS down
	strh	R1, [R12, #GPIO_PC_DOUTCLR]
	PUT	0xF9, USARTn_IFC, USART0 ; clear USART interrupt flags
	PUT	0x02, USARTn_IEN	; enable TXBL interrupt
	wfi
	movw	R1, #CS			; CS up
	strh	R1, [R12, #GPIO_PC_DOUTSET]
	bx	LR
	ENDP
	
;-------------------------------------------------------------------	
	ALIGN
SI4461_Config	
        DCB     0x1E    ; config data size
        DCB     0x07, 0x02, 0x01, 0x00, 0x01, 0xC9, 0xC3, 0x80
        DCB     0x08, 0x13, 0x00, 0x00, 0x00, 0x00, 0x00, 0x00, 0x00
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        DCB     0x10, 0x11, 0x21, 0x0C, 0x18, 0xC8, 0xC7, 0xDB, 0xF2, 0x02, 0x08, 0x07, 0x03, 0x15, 0xFC, 0x0F, 0x00
	DCB     0x08, 0x11, 0x22, 0x04, 0x00, 0x21, 0x64, 0x2E, 0x3D ;0x20, 0x2F, 0x00, 0x3D	
        DCB     0x0B, 0x11, 0x23, 0x07, 0x00, 0x2C, 0x0E, 0x0B, 0x04, 0x0C, 0x73, 0x03
        DCB     0x10, 0x11, 0x30, 0x0C, 0x00, 0x00, 0x00, 0x00, 0x00, 0x00, 0x00, 0x00, 0x00, 0x00, 0x00, 0x00, 0x00
        DCB     0x0C, 0x11, 0x40, 0x08, 0x00, 0x3B, 0x09, 0x99, 0x99, 0x22, 0x22, 0x20, 0xFF

	ALIGN
	END	